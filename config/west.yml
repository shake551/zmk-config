## config/west.yml
```yaml
manifest:
  remotes:
    - name: zmkfirmware
      url-base: https://github.com/zmkfirmware
    - name: shake551
      url-base: https://github.com/shake551
  projects:
    - name: zmk
      remote: zmkfirmware
      revision: main
      import: app/west.yml
    - name: zmk-pmw3610-driver
      remote: shake551
      revision: fix/zephyr-4.1-compatible-rename
  self:
    path: config
```
